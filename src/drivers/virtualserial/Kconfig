## src/drivers/virtualserial/Kconfig
```kconfig
menuconfig DRIVERS_VIRTUALSERIAL
	bool "virtualserial"
	default n
	---help---
		Enable the virtualserial bridge for MAVLink SERIAL_CONTROL
		devices 100 through 109. Incoming MAVLink data is published on
		VirtualSerialTransmit and replies are accepted on
		VirtualSerialReceive.
```

## src/modules/ekf2zai/Kconfig
```kconfig
menuconfig MODULES_EKF2ZAI
	bool "ekf2zai"
	default n
	depends on MODULES_EKF2
	depends on EKF2_SOLUTION_SEPARATION
	---help---
		EKF2 with dual-output solution-separation companion (ModalAI).
		Start "ekf2zai" instead of "ekf2".
```
