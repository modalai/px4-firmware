## src/drivers/actuators/voxl_esc/Kconfig
```kconfig
menuconfig DRIVERS_ACTUATORS_VOXL_ESC
	bool "voxl_esc"
	default n
	---help---
		Enable support for voxl_esc

if DRIVERS_ACTUATORS_VOXL_ESC

	config VOXL_ESC_UART_DEBUG_LOG
		bool "UART debug logging"
		default n
		---help---
			Enable UART communication debug logging for the VOXL ESC
			driver. Instruments uart_write/uart_read with timestamps
			and logs raw bytes to a binary file via a background
			flush thread. Adds ~16KB buffer and one background thread.

endif
```

## src/drivers/barometer/invensense/icp10111/Kconfig
```kconfig
menuconfig DRIVERS_BAROMETER_INVENSENSE_ICP10111
	bool "icp10111"
	default n
	---help---
		Enable support for icp10111
```

## src/drivers/barometer/invensense/icp20100/Kconfig
```kconfig
menuconfig DRIVERS_BAROMETER_INVENSENSE_ICP20100
	bool "icp20100"
	default n
	---help---
		Enable support for icp20100
```

## src/drivers/osd/msp_dp/Kconfig
```kconfig
menuconfig DRIVERS_OSD_MSP_DP
	bool "msp_dp"
	default n
	---help---
		Enable support for msp_dp

menuconfig USER_MSP_DP
	bool "msp_dp running as userspace module"
	default y
	depends on BOARD_PROTECTED && DRIVERS_OSD_MSP_DP
	---help---
		Put msp_dp in userspace memory
```

## src/drivers/uart_esc/Kconfig
```kconfig
menu "UART_ESC"
    menuconfig COMMON_UART_ESC
        bool "Common UART ESC's"
        default n
        select DRIVERS_UART_ESC_MODALAI_ESC
        ---help---
            Enable default set of UART ESC drivers
    rsource "*/Kconfig"
endmenu
```

## src/drivers/uart_esc/modalai_esc/Kconfig
```kconfig
menuconfig DRIVERS_UART_ESC_MODALAI_ESC
	bool "modalai_esc"
	default n
	---help---
		Enable support for ModalAI ESC
```

## src/lib/parameters/Kconfig
```kconfig
menuconfig PARAM_SERVER
	bool "parameter server"
	default n
	---help---
		Enable support for the parameter server when enabling one or more parameter clients

menuconfig PARAM_CLIENT
	bool "parameter client"
	default n
	---help---
		Enable support for the parameter client
```

## src/modules/global_origin/Kconfig
```kconfig
menuconfig MODULES_GLOBAL_ORIGIN
	bool "global_origin"
	default n
	---help---
		Automatically set global origin and initial position
```

## src/modules/muorb/Kconfig
```kconfig
menuconfig MODULES_MUORB
        bool "muorb"
        default n
        ---help---
                Enable support for muorb apps

menuconfig USER_MUORB
	bool "muorb running as userspace module"
	default y
	depends on BOARD_PROTECTED && MODULES_MUORB
	---help---
		Put muorb in userspace memory
```

## src/modules/muorb_tester/Kconfig
```kconfig
menuconfig MODULES_MUORB_TESTER
	bool "muorb_tester"
	default n
	---help---
		Enable support for muorb tester
```

## src/systemcmds/modalai/Kconfig
```kconfig
menuconfig SYSTEMCMDS_MODALAI
	bool "modalai"
	default n
	---help---
		Enable support for modalai
```
